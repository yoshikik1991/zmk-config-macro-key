## config/boards/arm/macro_key/Kconfig
```kconfig
# SPDX-License-Identifier: MIT

config BOARD_ENABLE_DCDC
    bool "Enable DCDC mode"
    select SOC_DCDC_NRF52X
    default y
    depends on (BOARD_MACRO_KEY)

config BOARD_ENABLE_DCDC_HV
    bool "Enable DCDC mode"
    select SOC_DCDC_NRF52X
    default y
    depends on (BOARD_MACRO_KEY)
```

## config/boards/arm/macro_key/Kconfig.board
```kconfig
# SPDX-License-Identifier: MIT

config BOARD_MACRO_KEY
    bool "macro_key"
    depends on SOC_NRF52840_QIAA
```

## config/boards/arm/macro_key/Kconfig.defconfig
```kconfig
# Copyright (c) 2021 The ZMK Contributors
# SPDX-License-Identifier: MIT

if BOARD_MACRO_KEY
config BOARD
	default "macro_key"

config ZMK_KEYBOARD_NAME
	default "Macro Key"

if USB

config USB_NRFX
	default y

config USB_DEVICE_STACK
	default y

endif # USB

config BT_CTLR
	default BT

config ZMK_BLE
	default y

config ZMK_USB
	default y

config ZMK_BATTERY_VOLTAGE_DIVIDER
	default y

#for analog pointing
config ZMK_POINTING
    default y

config ADC
    default y

config ADC_ASYNC
    default y

config ANALOG_INPUT
    default y

config ANALOG_INPUT_LOG_DBG_RAW
    default y

config ANALOG_INPUT_LOG_DBG_REPORT
    default y

# config CONFIG_ADC
#     default y

# config CONFIG_ADC_ASYNC
#     default y

# config CONFIG_ANALOG_INPUT
#     default y

# config CONFIG_ANALOG_INPUT_LOG_DBG_RAW
#     default y

# config CONFIG_ANALOG_INPUT_LOG_DBG_REPORT
#     default y

endif # BOARD_MACRO_KEY
```
